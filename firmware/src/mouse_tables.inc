// Auto-generated by gen_mouse_tables.py - do not edit
// Lookup tables for SPItFIRE mouse quadrature decoding

#include <avr/pgmspace.h>
#include <stdint.h>

// Compact mouse pinout:
//   XA=PD4, XB=PD0, YA=PD6, YB=PD3
//   Buttons: Left=PD5, Right=PD1, Middle=PD2
const uint8_t remap_compact[128] PROGMEM = {
    0x00, 0x02, 0x00, 0x02, 0x00, 0x02, 0x00, 0x02, 0x08, 0x0A, 0x08, 0x0A, 0x08, 0x0A, 0x08, 0x0A,
    0x01, 0x03, 0x01, 0x03, 0x01, 0x03, 0x01, 0x03, 0x09, 0x0B, 0x09, 0x0B, 0x09, 0x0B, 0x09, 0x0B,
    0x00, 0x02, 0x00, 0x02, 0x00, 0x02, 0x00, 0x02, 0x08, 0x0A, 0x08, 0x0A, 0x08, 0x0A, 0x08, 0x0A,
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    0x05, 0x07, 0x05, 0x07, 0x05, 0x07, 0x05, 0x07, 0x0D, 0x0F, 0x0D, 0x0F, 0x0D, 0x0F, 0x0D, 0x0F,
};

const uint8_t btn_remap_compact[128] PROGMEM = {
    0x07, 0x07, 0x05, 0x05, 0x03, 0x03, 0x01, 0x01, 0x07, 0x07, 0x05, 0x05, 0x03, 0x03, 0x01, 0x01,
    0x07, 0x07, 0x05, 0x05, 0x03, 0x03, 0x01, 0x01, 0x07, 0x07, 0x05, 0x05, 0x03, 0x03, 0x01, 0x01,
    0x06, 0x06, 0x04, 0x04, 0x02, 0x02, 0x00, 0x00, 0x06, 0x06, 0x04, 0x04, 0x02, 0x02, 0x00, 0x00,
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    0x06, 0x06, 0x04, 0x04, 0x02, 0x02, 0x00, 0x00, 0x06, 0x06, 0x04, 0x04, 0x02, 0x02, 0x00, 0x00,
};

// Amiga mouse pinout:
//   XA=PD1, XB=PD3, YA=PD0, YB=PD2
//   Buttons: Left=PD5, Right=PD6, Middle=PD4
const uint8_t remap_amiga[128] PROGMEM = {
    0x00, 0x04, 0x01, 0x05, 0x08, 0x0C, 0x09, 0x0D, 0x02, 0x06, 0x03, 0x07, 0x0A, 0x0E, 0x0B, 0x0F,
    0x00, 0x04, 0x01, 0x05, 0x08, 0x0C, 0x09, 0x0D, 0x02, 0x06, 0x03, 0x07, 0x0A, 0x0E, 0x0B, 0x0F,
    0x00, 0x04, 0x01, 0x05, 0x08, 0x0C, 0x09, 0x0D, 0x02, 0x06, 0x03, 0x07, 0x0A, 0x0E, 0x0B, 0x0F,
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    0x00, 0x04, 0x01, 0x05, 0x08, 0x0C, 0x09, 0x0D, 0x02, 0x06, 0x03, 0x07, 0x0A, 0x0E, 0x0B, 0x0F,
};

const uint8_t btn_remap_amiga[128] PROGMEM = {
    0x07, 0x07, 0x07, 0x07, 0x07, 0x07, 0x07, 0x07, 0x07, 0x07, 0x07, 0x07, 0x07, 0x07, 0x07, 0x07,
    0x03, 0x03, 0x03, 0x03, 0x03, 0x03, 0x03, 0x03, 0x03, 0x03, 0x03, 0x03, 0x03, 0x03, 0x03, 0x03,
    0x06, 0x06, 0x06, 0x06, 0x06, 0x06, 0x06, 0x06, 0x06, 0x06, 0x06, 0x06, 0x06, 0x06, 0x06, 0x06,
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    0x00, 0x00, 0x00, 0x00, 0x00, 0x00, 0x00, 0x00, 0x00, 0x00, 0x00, 0x00, 0x00, 0x00, 0x00, 0x00,
};

// Atari mouse pinout:
//   XA=PD1, XB=PD0, YA=PD2, YB=PD3
//   Buttons: Left=PD5, Right=PD6
const uint8_t remap_atari[128] PROGMEM = {
    0x00, 0x02, 0x01, 0x03, 0x04, 0x06, 0x05, 0x07, 0x08, 0x0A, 0x09, 0x0B, 0x0C, 0x0E, 0x0D, 0x0F,
    0x00, 0x02, 0x01, 0x03, 0x04, 0x06, 0x05, 0x07, 0x08, 0x0A, 0x09, 0x0B, 0x0C, 0x0E, 0x0D, 0x0F,
    0x00, 0x02, 0x01, 0x03, 0x04, 0x06, 0x05, 0x07, 0x08, 0x0A, 0x09, 0x0B, 0x0C, 0x0E, 0x0D, 0x0F,
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    0x00, 0x02, 0x01, 0x03, 0x04, 0x06, 0x05, 0x07, 0x08, 0x0A, 0x09, 0x0B, 0x0C, 0x0E, 0x0D, 0x0F,
};

const uint8_t btn_remap_atari[128] PROGMEM = {
    0x03, 0x03, 0x03, 0x03, 0x03, 0x03, 0x03, 0x03, 0x03, 0x03, 0x03, 0x03, 0x03, 0x03, 0x03, 0x03,
    0x03, 0x03, 0x03, 0x03, 0x03, 0x03, 0x03, 0x03, 0x03, 0x03, 0x03, 0x03, 0x03, 0x03, 0x03, 0x03,
    0x02, 0x02, 0x02, 0x02, 0x02, 0x02, 0x02, 0x02, 0x02, 0x02, 0x02, 0x02, 0x02, 0x02, 0x02, 0x02,
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    0x00, 0x00, 0x00, 0x00, 0x00, 0x00, 0x00, 0x00, 0x00, 0x00, 0x00, 0x00, 0x00, 0x00, 0x00, 0x00,
};

// Busmouse mouse pinout:
//   XA=PD1, XB=PD2, YA=PD3, YB=PD4
//   Buttons: Left=PD5
const uint8_t remap_busmouse[128] PROGMEM = {
    0x00, 0x00, 0x01, 0x01, 0x02, 0x02, 0x03, 0x03, 0x04, 0x04, 0x05, 0x05, 0x06, 0x06, 0x07, 0x07,
    0x08, 0x08, 0x09, 0x09, 0x0A, 0x0A, 0x0B, 0x0B, 0x0C, 0x0C, 0x0D, 0x0D, 0x0E, 0x0E, 0x0F, 0x0F,
    0x00, 0x00, 0x01, 0x01, 0x02, 0x02, 0x03, 0x03, 0x04, 0x04, 0x05, 0x05, 0x06, 0x06, 0x07, 0x07,
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    0x08, 0x08, 0x09, 0x09, 0x0A, 0x0A, 0x0B, 0x0B, 0x0C, 0x0C, 0x0D, 0x0D, 0x0E, 0x0E, 0x0F, 0x0F,
};

const uint8_t btn_remap_busmouse[128] PROGMEM = {
    0x01, 0x01, 0x01, 0x01, 0x01, 0x01, 0x01, 0x01, 0x01, 0x01, 0x01, 0x01, 0x01, 0x01, 0x01, 0x01,
    0x01, 0x01, 0x01, 0x01, 0x01, 0x01, 0x01, 0x01, 0x01, 0x01, 0x01, 0x01, 0x01, 0x01, 0x01, 0x01,
    0x00, 0x00, 0x00, 0x00, 0x00, 0x00, 0x00, 0x00, 0x00, 0x00, 0x00, 0x00, 0x00, 0x00, 0x00, 0x00,
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    0x00, 0x00, 0x00, 0x00, 0x00, 0x00, 0x00, 0x00, 0x00, 0x00, 0x00, 0x00, 0x00, 0x00, 0x00, 0x00,
};

// Trackerball mouse pinout:
//   XA=PD4, XB=PD5, YA=PD1, YB=PD6
//   Buttons: Left=PD0, Right=PD3, Middle=PD2
const uint8_t remap_trackerball[128] PROGMEM = {
    0x00, 0x00, 0x04, 0x04, 0x00, 0x00, 0x04, 0x04, 0x00, 0x00, 0x04, 0x04, 0x00, 0x00, 0x04, 0x04,
    0x01, 0x01, 0x05, 0x05, 0x01, 0x01, 0x05, 0x05, 0x01, 0x01, 0x05, 0x05, 0x01, 0x01, 0x05, 0x05,
    0x02, 0x02, 0x06, 0x06, 0x02, 0x02, 0x06, 0x06, 0x02, 0x02, 0x06, 0x06, 0x02, 0x02, 0x06, 0x06,
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    0x0B, 0x0B, 0x0F, 0x0F, 0x0B, 0x0B, 0x0F, 0x0F, 0x0B, 0x0B, 0x0F, 0x0F, 0x0B, 0x0B, 0x0F, 0x0F,
};

const uint8_t btn_remap_trackerball[128] PROGMEM = {
    0x07, 0x06, 0x07, 0x06, 0x03, 0x02, 0x03, 0x02, 0x05, 0x04, 0x05, 0x04, 0x01, 0x00, 0x01, 0x00,
    0x07, 0x06, 0x07, 0x06, 0x03, 0x02, 0x03, 0x02, 0x05, 0x04, 0x05, 0x04, 0x01, 0x00, 0x01, 0x00,
    0x07, 0x06, 0x07, 0x06, 0x03, 0x02, 0x03, 0x02, 0x05, 0x04, 0x05, 0x04, 0x01, 0x00, 0x01, 0x00,
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    0x07, 0x06, 0x07, 0x06, 0x03, 0x02, 0x03, 0x02, 0x05, 0x04, 0x05, 0x04, 0x01, 0x00, 0x01, 0x00,
};

// Pulse + direction decode tables (Acorn-ecosystem mice)
// XA/YA are pulse signals, XB/YB are direction signals
// Index: (prev_state << 4) | curr_state
// Packed nibble: bit0=XA, bit1=XB, bit2=YA, bit3=YB
// Values: 0x00=no change, 0x01=+1, 0xFF=-1

const uint8_t pulse_dx_table[256] PROGMEM = {
    0x00, 0xFF, 0x00, 0x01, 0x00, 0xFF, 0x00, 0x01, 0x00, 0xFF, 0x00, 0x01, 0x00, 0xFF, 0x00, 0x01,
    0xFF, 0x00, 0x01, 0x00, 0xFF, 0x00, 0x01, 0x00, 0xFF, 0x00, 0x01, 0x00, 0xFF, 0x00, 0x01, 0x00,
    0x00, 0xFF, 0x00, 0x01, 0x00, 0xFF, 0x00, 0x01, 0x00, 0xFF, 0x00, 0x01, 0x00, 0xFF, 0x00, 0x01,
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    0xFF, 0x00, 0x01, 0x00, 0xFF, 0x00, 0x01, 0x00, 0xFF, 0x00, 0x01, 0x00, 0xFF, 0x00, 0x01, 0x00,
};

const uint8_t pulse_dy_table[256] PROGMEM = {
    0x00, 0x00, 0x00, 0x00, 0xFF, 0xFF, 0xFF, 0xFF, 0x00, 0x00, 0x00, 0x00, 0x01, 0x01, 0x01, 0x01,
    0x00, 0x00, 0x00, 0x00, 0xFF, 0xFF, 0xFF, 0xFF, 0x00, 0x00, 0x00, 0x00, 0x01, 0x01, 0x01, 0x01,
    0x00, 0x00, 0x00, 0x00, 0xFF, 0xFF, 0xFF, 0xFF, 0x00, 0x00, 0x00, 0x00, 0x01, 0x01, 0x01, 0x01,
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    0xFF, 0xFF, 0xFF, 0xFF, 0x00, 0x00, 0x00, 0x00, 0x01, 0x01, 0x01, 0x01, 0x00, 0x00, 0x00, 0x00,
};

// True quadrature decode tables (Amiga/Atari/Bus mice)
// Both signals are 90-degree offset square waves
// Index: (prev_state << 4) | curr_state
// Values: 0x00=no change, 0x01=+1, 0xFF=-1

const uint8_t quad_dx_table[256] PROGMEM = {
    0x00, 0x01, 0xFF, 0x00, 0x00, 0x01, 0xFF, 0x00, 0x00, 0x01, 0xFF, 0x00, 0x00, 0x01, 0xFF, 0x00,
    0xFF, 0x00, 0x00, 0x01, 0xFF, 0x00, 0x00, 0x01, 0xFF, 0x00, 0x00, 0x01, 0xFF, 0x00, 0x00, 0x01,
    0x01, 0x00, 0x00, 0xFF, 0x01, 0x00, 0x00, 0xFF, 0x01, 0x00, 0x00, 0xFF, 0x01, 0x00, 0x00, 0xFF,
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    0x00, 0xFF, 0x01, 0x00, 0x00, 0xFF, 0x01, 0x00, 0x00, 0xFF, 0x01, 0x00, 0x00, 0xFF, 0x01, 0x00,
};

const uint8_t quad_dy_table[256] PROGMEM = {
    0x00, 0x00, 0x00, 0x00, 0x01, 0x01, 0x01, 0x01, 0xFF, 0xFF, 0xFF, 0xFF, 0x00, 0x00, 0x00, 0x00,
    0x00, 0x00, 0x00, 0x00, 0x01, 0x01, 0x01, 0x01, 0xFF, 0xFF, 0xFF, 0xFF, 0x00, 0x00, 0x00, 0x00,
    0x00, 0x00, 0x00, 0x00, 0x01, 0x01, 0x01, 0x01, 0xFF, 0xFF, 0xFF, 0xFF, 0x00, 0x00, 0x00, 0x00,
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    0x00, 0x00, 0x00, 0x00, 0xFF, 0xFF, 0xFF, 0xFF, 0x01, 0x01, 0x01, 0x01, 0x00, 0x00, 0x00, 0x00,
};
